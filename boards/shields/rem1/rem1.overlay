#include <dt-bindings/zmk/matrix_transform.h>

/ {
    chosen {
        zmk,kscan = &kscan0;
    };

    kscan0: kscan_0 {
        compatible = "zmk,kscan-gpio-matrix";
        
        diode-direction = "col2row";

        /* --- Define your row pins --- */
        row-gpios = <&gpio0 24 (GPIO_ACTIVE_HIGH | GPIO_PULL_DOWN)>,   /* ROW1 */
                    <&gpio1 0 (GPIO_ACTIVE_HIGH | GPIO_PULL_DOWN)>,   /* ROW2 */
                    <&gpio0 11 (GPIO_ACTIVE_HIGH | GPIO_PULL_DOWN)>,   /* ROW3 */
                    <&gpio1 4 (GPIO_ACTIVE_HIGH | GPIO_PULL_DOWN)>,   /* ROW4 */
                    <&gpio1 06 (GPIO_ACTIVE_HIGH | GPIO_PULL_DOWN)>;   /* ROW5 */

        /* --- Define your column pins --- */
        col-gpios = <&gpio0 6 (GPIO_ACTIVE_HIGH)>,   /* COL1 */
                    <&gpio0 8 (GPIO_ACTIVE_HIGH)>,   /* COL2 */
                    <&gpio0 17 (GPIO_ACTIVE_HIGH)>,   /* COL3 */
                    <&gpio0 31 (GPIO_ACTIVE_HIGH)>,   /* COL4 */
                    <&gpio0 29 (GPIO_ACTIVE_HIGH)>,   /* COL5 */
                    <&gpio0 2 (GPIO_ACTIVE_HIGH)>,   /* COL6 */
                    <&gpio1 15 (GPIO_ACTIVE_HIGH)>,   /* COL7 */
                    <&gpio1 13 (GPIO_ACTIVE_HIGH)>,   /* COL8 */
                    <&gpio1 11 (GPIO_ACTIVE_HIGH)>,   /* COL9 */
                    <&gpio0 10 (GPIO_ACTIVE_HIGH)>,   /* COL10 */
                    <&gpio0 9 (GPIO_ACTIVE_HIGH)>,   /* COL11 */
                    <&gpio0 20 (GPIO_ACTIVE_HIGH)>,   /* COL12 */
                    <&gpio0 22 (GPIO_ACTIVE_HIGH)>;   /* COL13 */

    };
};
