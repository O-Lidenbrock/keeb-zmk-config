/ {
    chosen {
        zmk,kscan = &kscan0;
    };

    kscan0: kscan {
        compatible = "zmk,kscan-gpio-matrix";

        /* --- Define your row pins --- */
        row-gpios = <&gpio0 13 (GPIO_ACTIVE_LOW)>,   /* ROW1 */
                    <&gpio0 15 (GPIO_ACTIVE_LOW)>,   /* ROW2 */
                    <&gpio0 17 (GPIO_ACTIVE_LOW)>,   /* ROW3 */
                    <&gpio0 20 (GPIO_ACTIVE_LOW)>,   /* ROW4 */
                    <&gpio0 22 (GPIO_ACTIVE_LOW)>;   /* ROW5 */

        /* --- Define your column pins --- */
        col-gpios = <&gpio0 24 (GPIO_ACTIVE_LOW)>,   /* COL1 */
                    <&gpio0 25 (GPIO_ACTIVE_LOW)>,   /* COL2 */
                    <&gpio0 26 (GPIO_ACTIVE_LOW)>,   /* COL3 */
                    <&gpio0 27 (GPIO_ACTIVE_LOW)>,   /* COL4 */
                    <&gpio0 28 (GPIO_ACTIVE_LOW)>,   /* COL5 */
                    <&gpio0 29 (GPIO_ACTIVE_LOW)>,   /* COL6 */
                    <&gpio1 0  (GPIO_ACTIVE_LOW)>,   /* COL7 */
                    <&gpio1 1  (GPIO_ACTIVE_LOW)>,   /* COL8 */
                    <&gpio1 2  (GPIO_ACTIVE_LOW)>,   /* COL9 */
                    <&gpio1 3  (GPIO_ACTIVE_LOW)>,   /* COL10 */
                    <&gpio1 4  (GPIO_ACTIVE_LOW)>,   /* COL11 */
                    <&gpio1 5  (GPIO_ACTIVE_LOW)>,   /* COL12 */
                    <&gpio1 6  (GPIO_ACTIVE_LOW)>;   /* COL13 */

        diode-direction = "COL2ROW";
    };
};
